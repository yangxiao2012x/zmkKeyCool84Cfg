## config/boards/shields/eskeycool84/Kconfig.defconfig
```kconfig
# Copyright (c) 2021 The ZMK Contributors
# SPDX-License-Identifier: MIT

if SHIELD_ESKEYCOOL84

config ZMK_KEYBOARD_NAME
    default "eskeycool84"

endif
```
